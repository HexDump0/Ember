## firmware/main/Kconfig.projbuild
```kconfig
menu "Ember"

config EMBER_FAKE_SENSORS
    bool "Use synthetic sensor data instead of MPU6050/BMP280"
    default n
    help
        If enabled sensors_read() will return time varying synthetic
        data instead of a using the real sensors. Made for testing firmware in QEMU.

endmenu
```

## firmware/sdkconfig.defaults
```kconfig
CONFIG_IDF_TARGET="esp32c3"

CONFIG_PARTITION_TABLE_CUSTOM=y
CONFIG_PARTITION_TABLE_CUSTOM_FILENAME="partitions.csv"
CONFIG_PARTITION_TABLE_FILENAME="partitions.csv"

CONFIG_ESPTOOLPY_FLASHSIZE_4MB=y
CONFIG_ESPTOOLPY_FLASHSIZE="4MB"

# 1 ms tick for accurate vTaskDelayUntil at 100 Hz.
CONFIG_FREERTOS_HZ=1000

CONFIG_LOG_DEFAULT_LEVEL_INFO=y

CONFIG_HTTPD_WS_SUPPORT=y
CONFIG_HTTPD_MAX_URI_HANDLERS=12
```
